## CMakeLists.txt
```
cmake_minimum_required(VERSION 3.20.0)
find_package(Zephyr REQUIRED HINTS $ENV{ZEPHYR_BASE})

# Helps VS Code IntelliSense by emitting compile_commands.json into the build dir.
set(CMAKE_EXPORT_COMPILE_COMMANDS ON CACHE BOOL "" FORCE)

project(lis302dl_test)

target_sources(app PRIVATE
	src/main.c
	src/lis302_accel.c
)

target_include_directories(app PRIVATE inc)
```

## prj.conf
```kconfig
CONFIG_STDOUT_CONSOLE=y
CONFIG_SPI=y
CONFIG_GPIO=y
CONFIG_MINIMAL_LIBC=y
```

## app.overlay
```dts
&spi1 {
	status = "okay";
	pinctrl-0 = <&spi1_sck_pa5 &spi1_miso_pa6 &spi1_mosi_pa7>;
	pinctrl-names = "default";
	cs-gpios = <&gpioe 3 GPIO_ACTIVE_LOW>;
};
```

## src/main.c
```c
#include <zephyr/kernel.h>
#include <zephyr/sys/printk.h>

#include <errno.h>

#include "lis302_accel.h"

int main(void)
{
	struct lis_accel_device accel;
	int ret = lis_accel_init(&accel);
	if (ret != 0) {
		printk("Accelerometer init failed (%d)\n", ret);
		return 0;
	}

	printk("Accelerometer WHOAMI=0x%02x (%s)\n", accel.whoami, lis_accel_type_str(accel.type));
	printk("Init OK\n");

	while (1) {
		struct lis_accel_sample s;
		ret = lis_accel_read(&accel, &s);
		if (ret == -EAGAIN) {
			k_sleep(K_MSEC(10));
			continue;
		}
		if (ret != 0) {
			printk("read failed (%d)\n", ret);
			k_sleep(K_MSEC(50));
			continue;
		}

		if (accel.type == LIS_ACCEL_LIS302DL) {
			printk("raw8: x=%d y=%d z=%d\n", (int)s.x, (int)s.y, (int)s.z);
		} else if (accel.type == LIS_ACCEL_LIS3DSH) {
			static uint32_t count;
			if ((count++ % 20U) == 0U) {
				printk("status=0x%02x\n", s.status);
			}
			printk("raw16: x=%d y=%d z=%d | mg: x=%ld y=%ld z=%ld\n",
			       s.x, s.y, s.z,
			       (long)s.x_mg, (long)s.y_mg, (long)s.z_mg);
		} else {
			printk("Unknown accel type\n");
		}

		k_sleep(K_MSEC(50));
	}
}
```

## inc/lis302_accel.h
```c
#ifndef LIS302_ACCEL_H_
#define LIS302_ACCEL_H_

#include <stdint.h>

#include <zephyr/kernel.h>
#include <zephyr/drivers/spi.h>

/* SPI command bits used by ST MEMS */
#define ST_SPI_READ     0x80
#define ST_SPI_AUTOINC  0x40

/* LIS302DL (WHOAMI 0x3B) registers (subset) */
#define LIS302DL_WHOAMI     0x0F
#define LIS302DL_CTRL1      0x20
#define LIS302DL_OUT_X      0x29
#define LIS302DL_OUT_Y      0x2B
#define LIS302DL_OUT_Z      0x2D

/* LIS3DSH (WHOAMI 0x3F) registers (subset) */
#define LIS3DSH_WHOAMI      0x0F
#define LIS3DSH_CTRL4       0x20
#define LIS3DSH_CTRL5       0x24
#define LIS3DSH_STATUS      0x27
#define LIS3DSH_OUT_X_L     0x28

/* Scaling assumption for LIS3DSH processed output (mg). */
#define LIS3DSH_LSB_PER_G    16384

enum lis_accel_type {
	LIS_ACCEL_UNKNOWN = 0,
	LIS_ACCEL_LIS302DL,
	LIS_ACCEL_LIS3DSH,
};

struct lis_accel_device {
	struct spi_dt_spec spi;
	enum lis_accel_type type;
	uint8_t whoami;
};

struct lis_accel_sample {
	int16_t x;
	int16_t y;
	int16_t z;
	int32_t x_mg;
	int32_t y_mg;
	int32_t z_mg;
	uint8_t status;
};

int lis_accel_init(struct lis_accel_device *dev);
int lis_accel_read(struct lis_accel_device *dev, struct lis_accel_sample *sample);
const char *lis_accel_type_str(enum lis_accel_type type);

/* Lower-level helper APIs (exported for reuse in other modules). */
int st_spi_read_u8(const struct spi_dt_spec *spi, uint8_t reg, uint8_t *val);
int st_spi_write_u8(const struct spi_dt_spec *spi, uint8_t reg, uint8_t val);
int st_spi_read_u8_retry(const struct spi_dt_spec *spi, uint8_t reg, uint8_t *val, int tries);
int32_t counts_to_mg(int16_t counts);

/* Optional device-specific building blocks (also exported). */
int lis_spi_setup(struct spi_dt_spec *spi_out);
int lis302dl_init(const struct spi_dt_spec *spi);
int lis302dl_read(const struct spi_dt_spec *spi, struct lis_accel_sample *s);
int lis3dsh_init(const struct spi_dt_spec *spi);
int lis3dsh_read(const struct spi_dt_spec *spi, struct lis_accel_sample *s);

#endif /* LIS302_ACCEL_H_ */
```

## src/lis302_accel.c
```c
#include "lis302_accel.h"

#include <zephyr/device.h>
#include <zephyr/drivers/gpio.h>

#include <errno.h>

int st_spi_read_u8(const struct spi_dt_spec *spi, uint8_t reg, uint8_t *val)
{
	uint8_t tx[2] = { (uint8_t)(reg | ST_SPI_READ), 0x00 };
	uint8_t rx[2] = { 0 };
	struct spi_buf tx_buf = { .buf = tx, .len = sizeof(tx) };
	struct spi_buf rx_buf = { .buf = rx, .len = sizeof(rx) };
	struct spi_buf_set tx_set = { .buffers = &tx_buf, .count = 1 };
	struct spi_buf_set rx_set = { .buffers = &rx_buf, .count = 1 };
	int ret = spi_transceive_dt(spi, &tx_set, &rx_set);
	if (ret != 0) {
		return ret;
	}
	*val = rx[1];
	return 0;
}

int st_spi_write_u8(const struct spi_dt_spec *spi, uint8_t reg, uint8_t val)
{
	uint8_t tx[2] = { (uint8_t)(reg & (uint8_t)~ST_SPI_READ), val };
	struct spi_buf tx_buf = { .buf = tx, .len = sizeof(tx) };
	struct spi_buf_set tx_set = { .buffers = &tx_buf, .count = 1 };
	return spi_write_dt(spi, &tx_set);
}

int st_spi_read_u8_retry(const struct spi_dt_spec *spi, uint8_t reg, uint8_t *val, int tries)
{
	int ret;
	uint8_t v = 0;

	for (int i = 0; i < tries; i++) {
		ret = st_spi_read_u8(spi, reg, &v);
		if (ret != 0) {
			k_busy_wait(10);
			continue;
		}
		/* 0xFF is a common “bad read” signature on SPI (MISO pulled high). */
		if (v != 0xFF) {
			*val = v;
			return 0;
		}
		k_busy_wait(10);
	}

	*val = v;
	return -EIO;
}

int32_t counts_to_mg(int16_t counts)
{
	return ((int32_t)counts * 1000) / LIS3DSH_LSB_PER_G;
}

int lis_spi_setup(struct spi_dt_spec *spi_out)
{
	const struct device *const spi_dev = DEVICE_DT_GET(DT_NODELABEL(spi1));
	if (!device_is_ready(spi_dev)) {
		return -ENODEV;
	}

	const struct gpio_dt_spec cs_gpio =
		GPIO_DT_SPEC_GET_BY_IDX(DT_NODELABEL(spi1), cs_gpios, 0);
	if (!gpio_is_ready_dt(&cs_gpio)) {
		return -ENODEV;
	}

	int ret = gpio_pin_configure_dt(&cs_gpio, GPIO_OUTPUT_INACTIVE);
	if (ret != 0) {
		return ret;
	}

	const struct spi_cs_control cs_ctrl = {
		.gpio = cs_gpio,
		.delay = 5,
	};

	/* Conservative SPI settings for reliability. */
	*spi_out = (struct spi_dt_spec){
		.bus = spi_dev,
		.config = {
			.frequency = 400000,
			.operation = SPI_WORD_SET(8) | SPI_TRANSFER_MSB |
					SPI_MODE_CPOL | SPI_MODE_CPHA,
			.slave = 0,
			.cs = cs_ctrl,
		},
	};

	return 0;
}

int lis302dl_init(const struct spi_dt_spec *spi)
{
	return st_spi_write_u8(spi, LIS302DL_CTRL1, 0x47);
}

int lis302dl_read(const struct spi_dt_spec *spi, struct lis_accel_sample *s)
{
	uint8_t x_u = 0, y_u = 0, z_u = 0;
	int ret = 0;
	ret |= st_spi_read_u8(spi, LIS302DL_OUT_X, &x_u);
	ret |= st_spi_read_u8(spi, LIS302DL_OUT_Y, &y_u);
	ret |= st_spi_read_u8(spi, LIS302DL_OUT_Z, &z_u);
	if (ret != 0) {
		return -EIO;
	}

	s->x = (int16_t)(int8_t)x_u;
	s->y = (int16_t)(int8_t)y_u;
	s->z = (int16_t)(int8_t)z_u;
	s->x_mg = 0;
	s->y_mg = 0;
	s->z_mg = 0;
	s->status = 0;
	return 0;
}

int lis3dsh_init(const struct spi_dt_spec *spi)
{
	int ret = st_spi_write_u8(spi, LIS3DSH_CTRL4, 0x6F);
	if (ret != 0) {
		return ret;
	}
	return st_spi_write_u8(spi, LIS3DSH_CTRL5, 0x00);
}

int lis3dsh_read(const struct spi_dt_spec *spi, struct lis_accel_sample *s)
{
	uint8_t status = 0;
	int ret = st_spi_read_u8_retry(spi, LIS3DSH_STATUS, &status, 3);
	if (ret != 0) {
		return ret;
	}
	/* ZYXDA (bit3) indicates new XYZ data available. */
	if ((status & 0x08) == 0) {
		return -EAGAIN;
	}

	uint8_t xl = 0, xh = 0, yl = 0, yh = 0, zl = 0, zh = 0;
	ret = 0;
	ret |= st_spi_read_u8(spi, LIS3DSH_OUT_X_L, &xl);
	ret |= st_spi_read_u8(spi, LIS3DSH_OUT_X_L + 1, &xh);
	ret |= st_spi_read_u8(spi, LIS3DSH_OUT_X_L + 2, &yl);
	ret |= st_spi_read_u8(spi, LIS3DSH_OUT_X_L + 3, &yh);
	ret |= st_spi_read_u8(spi, LIS3DSH_OUT_X_L + 4, &zl);
	ret |= st_spi_read_u8(spi, LIS3DSH_OUT_X_L + 5, &zh);
	if (ret != 0) {
		return -EIO;
	}

	s->x = (int16_t)((uint16_t)xh << 8 | xl);
	s->y = (int16_t)((uint16_t)yh << 8 | yl);
	s->z = (int16_t)((uint16_t)zh << 8 | zl);
	s->x_mg = counts_to_mg(s->x);
	s->y_mg = counts_to_mg(s->y);
	s->z_mg = counts_to_mg(s->z);
	s->status = status;
	return 0;
}

const char *lis_accel_type_str(enum lis_accel_type type)
{
	switch (type) {
	case LIS_ACCEL_LIS302DL:
		return "LIS302DL";
	case LIS_ACCEL_LIS3DSH:
		return "LIS3DSH";
	default:
		return "UNKNOWN";
	}
}

int lis_accel_init(struct lis_accel_device *dev)
{
	if (dev == NULL) {
		return -EINVAL;
	}

	int ret = lis_spi_setup(&dev->spi);
	if (ret != 0) {
		dev->type = LIS_ACCEL_UNKNOWN;
		dev->whoami = 0;
		return ret;
	}

	uint8_t whoami = 0;
	ret = st_spi_read_u8(&dev->spi, 0x0F, &whoami);
	if (ret != 0) {
		dev->type = LIS_ACCEL_UNKNOWN;
		dev->whoami = 0;
		return ret;
	}
	dev->whoami = whoami;

	if (whoami == 0x3B) {
		dev->type = LIS_ACCEL_LIS302DL;
		return lis302dl_init(&dev->spi);
	}
	if (whoami == 0x3F) {
		dev->type = LIS_ACCEL_LIS3DSH;
		return lis3dsh_init(&dev->spi);
	}

	dev->type = LIS_ACCEL_UNKNOWN;
	return -ENODEV;
}

int lis_accel_read(struct lis_accel_device *dev, struct lis_accel_sample *sample)
{
	if (dev == NULL || sample == NULL) {
		return -EINVAL;
	}

	sample->x = 0;
	sample->y = 0;
	sample->z = 0;
	sample->x_mg = 0;
	sample->y_mg = 0;
	sample->z_mg = 0;
	sample->status = 0;

	switch (dev->type) {
	case LIS_ACCEL_LIS302DL:
		return lis302dl_read(&dev->spi, sample);
	case LIS_ACCEL_LIS3DSH:
		return lis3dsh_read(&dev->spi, sample);
	default:
		return -ENODEV;
	}
}
```
