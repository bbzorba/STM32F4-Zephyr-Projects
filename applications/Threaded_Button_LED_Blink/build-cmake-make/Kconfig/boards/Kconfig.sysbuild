## applications/Threaded_Button_LED_Blink/build-cmake-make/Kconfig/boards/Kconfig.sysbuild
```kconfig
# Load Sysbuild board Kconfig descriptions.
osource "/home/bbzorba/zephyrproject/zephyr/boards/st/stm32f4_disco/Kconfig.sysbuild"
```

## applications/Threaded_Button_LED_Blink/build-cmake/Kconfig/boards/Kconfig.defconfig
```kconfig
# Load Zephyr board defconfig descriptions.
osource "/home/bbzorba/zephyrproject/zephyr/boards/st/stm32f4_disco/Kconfig.defconfig"
```
